## boards/arm/olimexino_stm32f303rc/Kconfig.board
```kconfig
# NUCLEO-64 F303RE board configuration

# Copyright (c) 2020 Paul M. Bendixen
# SPDX-License-Identifier: Apache-2.0

config BOARD_OLIMEXINO_STM32F303RC
	bool "Olimexino STM32F303RC Development Board"
	depends on SOC_STM32F303XC
```

## boards/arm/olimexino_stm32f303rc/Kconfig.defconfig
```kconfig
# Olimexino STM32F303RC board configuration

# Copyright (c) 2020 Paul M. Bendixen
# SPDX-License-Identifier: Apache-2.0

if BOARD_OLIMEXINO_STM32F303RC

config BOARD
	default "olimexino_stm32f303rc"

endif # BOARD_OLIMEXINO_STM32F303RC
```

## boards/arm/pozyx_f401rc/Kconfig.board
```kconfig
# Pozyx F401RC board configuration

# Copyright (c) 2016 Linaro Limited.
# SPDX-License-Identifier: Apache-2.0

config BOARD_POZYX_F401RC
	bool "Pozyx F401RC Development Board"
	depends on SOC_STM32F401XC
```

## boards/arm/pozyx_f401rc/Kconfig.defconfig
```kconfig
# Pozyx F401RC board configuration

# Copyright (c) 2016 Linaro Limited.
# Copyright (c) 2019 Centaur Analytics, Inc
# SPDX-License-Identifier: Apache-2.0

if BOARD_POZYX_F401RC

config BOARD
	default "pozyx_f401rc"

config SPI_STM32_INTERRUPT
	default y
	depends on SPI

endif # BOARD_POZYX_F401RC
```

## boards/riscv/litex_vexriscv/Kconfig.defconfig
```kconfig
# Copyright (c) 2018 - 2019 Antmicro <www.antmicro.com>
# SPDX-License-Identifier: Apache-2.0

config BOARD
	default "litex_vexriscv"
	depends on BOARD_LITEX_VEXRISCV

config UART_CONSOLE_ON_DEV_NAME
	default "uart0"

config UART_SHELL_ON_DEV_NAME
	default "uart0"
```

## boards/riscv/litex_vexriscv/litex_vexriscv_defconfig
```kconfig
#
# Copyright (c) 2019 Antmicro <www.antmicro.com>
#
# SPDX-License-Identifier: Apache-2.0
#

CONFIG_SOC_RISCV32_LITEX_VEXRISCV=y
CONFIG_BOARD_LITEX_VEXRISCV=y
CONFIG_VEXRISCV_LITEX_IRQ=y
CONFIG_LITEX_TIMER=y
CONFIG_CONSOLE=y
CONFIG_SERIAL=y
CONFIG_UART_LITEUART=y
CONFIG_UART_CONSOLE=y
CONFIG_EARLY_CONSOLE=y
CONFIG_NETWORKING=n
CONFIG_ETH_LITEETH=n
CONFIG_ETH_LITEETH_0=n
CONFIG_NET_L2_ETHERNET=n
CONFIG_HWINFO=n
CONFIG_HWINFO_LITEX=n
CONFIG_SPI=n
CONFIG_SPI_LITESPI=n
CONFIG_GPIO=n
CONFIG_GPIO_LITEX=n
CONFIG_ENTROPY_LITEX_RNG=n
CONFIG_I2C=n
CONFIG_I2C_LITEX=n
CONFIG_PWM=n
CONFIG_PWM_LITEX=n
CONFIG_XIP=n
CONFIG_I2S=n
CONFIG_I2S_LITEX=n
CONFIG_CLOCK_CONTROL=n
CONFIG_CLOCK_CONTROL_LITEX=n
CONFIG_HEAP_MEM_POOL_SIZE=4096
```
