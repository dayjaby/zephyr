## prj.conf
```kconfig
#CONFIG_PRINTK=y
#CONFIG_SHELL=y
#CONFIG_LOG=y
#CONFIG_INIT_STACKS=y
#CONFIG_THREAD_STACK_INFO=y
#CONFIG_KERNEL_SHELL=y
#CONFIG_THREAD_MONITOR=y
#CONFIG_BOOT_BANNER=n
#CONFIG_THREAD_NAME=y
#CONFIG_DEVICE_SHELL=y
#CONFIG_POSIX_CLOCK=y
#CONFIG_DATE_SHELL=y
#CONFIG_THREAD_RUNTIME_STATS=y

CONFIG_UART_CONSOLE_ON_DEV_NAME="UART_1"
CONFIG_PRINTK=y
CONFIG_CONSOLE=y

CONFIG_LOG=y
CONFIG_UART_INTERRUPT_DRIVEN=y
CONFIG_SERIAL=y
CONFIG_STDOUT_CONSOLE=y
CONFIG_UART_CONSOLE=y
CONFIG_UART_SHELL_ON_DEV_NAME="UART_1"
CONFIG_SHELL_BACKEND_SERIAL=y
CONFIG_SHELL_BACKENDS=y
CONFIG_SHELL=y
```

## src/main.c
```c
/*
 * Copyright (c) 2012-2014 Wind River Systems, Inc.
 *
 * SPDX-License-Identifier: Apache-2.0
 */

#include <zephyr.h>
#include <sys/printk.h>
#include <drivers/uart.h>

#define MY_SERIAL DT_NODELABEL(usart1)

void main(void)
{
	struct device *dev = device_get_binding(DT_LABEL(MY_SERIAL));
	printk("Hello World! %s with console %s and dev %i\n", CONFIG_BOARD, DT_LABEL(MY_SERIAL), (int)dev);
	uart_poll_out(dev, 'A');
}
```
